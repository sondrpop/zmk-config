## config/west.yml
```yaml
manifest:
  remotes:
    - name: zmkfirmware
      url-base: https://github.com/zmkfirmware
    - name: voidyourwarranty2
      url-base: https://github.com/voidyourwarranty2
  projects:
    - name: zmk
      remote: voidyourwarranty2
      revision: devel-adaptive
      import: app/west.yml
  self:
    path: config
```
